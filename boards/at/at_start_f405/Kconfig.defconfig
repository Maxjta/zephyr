## boards/at/at_start_f405/Kconfig.defconfig
```kconfig
# AT-START-F405 board configuration

# Copyright (c) 2018 Philémon Jaermann
# SPDX-License-Identifier: Apache-2.0

#if BOARD_AT_START_F405

#config SPI_AT32_INTERRUPT
#	default y
#	depends on SPI

config USB_DW_USB_2_0
    default y

#endif # BOARD_AT_START_F405
```

## boards/at/at_start_f405/at_start_f405_defconfig
```kconfig
# SPDX-License-Identifier: Apache-2.0

CONFIG_SYS_CLOCK_HW_CYCLES_PER_SEC=216000000
 
# Enable MPU
CONFIG_ARM_MPU=n

# Enable HW stack protection
CONFIG_HW_STACK_PROTECTION=n

CONFIG_SERIAL=y
# console
CONFIG_CONSOLE=y
CONFIG_UART_CONSOLE=y

# enable GPIO
CONFIG_GPIO=y
CONFIG_PINCTRL=y

CONFIG_RESET=y
CONFIG_UART_INTERRUPT_DRIVEN=y

#enable SPI
#CONFIG_SPI=y
#CONFIG_SPI_AT32_DMA=y
```

## drivers/clock_control/Kconfig.at32
```kconfig
# Copyright (c) 2022 Teslabs Engineering S.L.
# SPDX-License-Identifier: Apache-2.0
#	depends on DT_HAS_AT_AT32_CCTL_ENABLED
config CLOCK_CONTROL_AT32
	bool "AT32 clock control"
	default y
	help
	  Enable driver for AT32 Reset Clock Unit (CRM).
```

## drivers/pinctrl/Kconfig.at32
```kconfig
# Copyright (c) 2021 Teslabs Engineering S.L.
# SPDX-License-Identifier: Apache-2.0

config PINCTRL_AT32_AF
	bool "AT32 AF pin controller driver"
	default y
	depends on DT_HAS_AT_AT32_PINCTRL_AF_ENABLED
	help
	  AT32 AF pin controller driver. This driver is used by series using the
	  AF pin multiplexing model.

#config PINCTRL_AT32_AFIO
#	bool "AT32 AFIO pin controller driver"
#	default y
#	depends on DT_HAS_AT_AT32_PINCTRL_AFIO_ENABLED
#	help
#	  GD32 AFIO pin controller driver. This driver is used by series using the
#	  AFIO pin multiplexing model.
```

## soc/at/at32/at32f402_405/Kconfig.defconfig
```kconfig
# Copyright (c) 2022 YuLong Yao <feilongphone@gmail.com>
# SPDX-License-Identifier: Apache-2.0

if SOC_SERIES_AT32F402_405

#config SOC_SERIES
#	default "at32f402_405"
	
rsource "Kconfig.defconfig.at32*"

endif # SOC_SERIES_AT32F402_405
```

## soc/at/at32/at32f402_405/Kconfig.defconfig.at32f405
```kconfig
# Copyright (c) 2021, ATL Electronics
# SPDX-License-Identifier: Apache-2.0

if SOC_AT32F405

config SYS_CLOCK_HW_CYCLES_PER_SEC
	default $(dt_node_int_prop_int,/clocks/sysclk,clock-frequency)

config NUM_IRQS
	default 104

endif # SOC_AT32F405
```
